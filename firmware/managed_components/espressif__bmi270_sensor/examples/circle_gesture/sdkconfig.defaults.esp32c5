## firmware/managed_components/espressif__bmi270_sensor/examples/shake/sdkconfig.defaults
```kconfig
CONFIG_PM_SLP_IRAM_OPT=y
CONFIG_ESP_TASK_WDT_EN=n
CONFIG_I2C_BUS_BACKWARD_CONFIG=y
CONFIG_I2C_BUS_SUPPORT_SOFTWARE=y
```

## firmware/managed_components/espressif__bmi270_sensor/test_apps/main/Kconfig.projbuild
```kconfig
menu "Example Configuration"

    choice BOARD_SELECTION
        prompt "Select Development Board"
        default BOARD_ESP_SPOT_C5
        help
            Select the development board you are using.

        config BOARD_ESP_SPOT_C5
            bool "ESP SPOT C5"
        config BOARD_ESP_SPOT_S3
            bool "ESP SPOT S3"
        config BOARD_ESP_ASTOM_S3
            bool "ESP ASTOM S3"
        config BOARD_ESP_ECHOEAR_S3
            bool "ESP ECHOEAR S3"
        config BOARD_CUSTOM
            bool "Other Boards"
    endchoice

    menu "Custom Board Configuration"
        depends on BOARD_CUSTOM
        help
            Configure GPIO pins and I2C settings for custom board.

        config I2C_INT_IO
            int "Interrupt GPIO Num"
            default 28
            range 0 48
            help
                GPIO number for interrupt line.

        config I2C_MASTER_SCL_IO
            int "SCL GPIO Num"
            default 3
            range 0 48
            help
                GPIO number for I2C Master clock line.

        config I2C_MASTER_SDA_IO
            int "SDA GPIO Num"
            default 2
            range 0 48
            help
                GPIO number for I2C Master data line.

        config UE_SW_I2C
            bool "Use Software I2C"
            default y
            help
                Enable software I2C implementation instead of hardware I2C.

    endmenu

endmenu
```
